## app/focus_aiot/Kconfig
```kconfig
config CONTEST2026_087_FOCUS_AIOT
	bool "Contest 2026 team 087 Focus AIoT UI"
	default n
	---help---
		Enable the Focus AIoT study-monitor UI and MiMo advice adapter.
```

## app/hello_app/Kconfig
```kconfig
#
# For a description of the syntax of this configuration file,
# see the file kconfig-language.txt in the NuttX tools repository.
#

config LVX_USE_DEMO_CONTEST2026_087_HELLO_APP
	bool "Contest 2026 team 087 hello app (hardware validation)"
	default n
	---help---
		Enable the contest 2026 team 087 hello app demo.
		当前为设备硬件验证测试程序 (LCD/LED/按键/摄像头/加速度计/SD)。

config CONTEST2026_087_LCD_STUB
	bool "Use temporary LCD framebuffer backend"
	default n
	depends on LVX_USE_DEMO_CONTEST2026_087_HELLO_APP
	---help---
		Enable the in-memory LCD backend instead of the real /dev/fb0
		ST7789V driver (hardware/lcd_st7789.c).

config CONTEST2026_087_WIFI_STUB
	bool "Use temporary offline Wi-Fi backend"
	default y
	depends on LVX_USE_DEMO_CONTEST2026_087_HELLO_APP
	---help---
		Keep MiMo in local fallback mode until the Wi-Fi module is linked.

config CONTEST2026_087_BUTTON_STUB
	bool "Use mock button backend"
	default y
	depends on LVX_USE_DEMO_CONTEST2026_087_HELLO_APP
	---help---
		Enable the mock button sequence instead of the real GPIO button
		driver (hardware/buttons.c).

config CONTEST2026_087_CAMERA_STUB
	bool "Use mock camera backend"
	default y
	depends on LVX_USE_DEMO_CONTEST2026_087_HELLO_APP
	---help---
		Enable the mock camera backend instead of the real OV2640 driver
		(hardware/camera_ov2640.c).

config CONTEST2026_087_AUDIO_STUB
	bool "Use mock audio backend"
	default y
	depends on LVX_USE_DEMO_CONTEST2026_087_HELLO_APP
	---help---
		Enable the mock audio backend instead of the real I2S/buzzer
		driver (hardware/audio_i2s.c).
```
